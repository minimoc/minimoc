#pragma once
// carousel_ui.h — Carousel icon menu for miniMoc (SSD1306 128x64, U8g2)
// Replaces the linear list menu with a horizontally scrolling icon selector.
// Icons: 32x32 (selected, center) and 16x16 (adjacent, sides).
// Bottom bar: name of selected item.

// -----------------------------------------------------------------
// ICON BITMAPS (16x16 and 32x32, XBM / U8g2 PROGMEM format)
// Add new icons by following the same pattern below and registering
// them in the carousel_items[] array at the bottom of this file.
// -----------------------------------------------------------------

// --- ROUTING icon (two arrows crossing) ---
// 16x16
static const unsigned char icon_routing_16[] PROGMEM = {
	0x00, 0x30, 0x00, 0xf0, 0x00, 0x70, 0x00, 0x30, 0x00, 0x10, 0xf8, 0x13, 0xfc, 0x13, 0x04, 0x00, 
	0x06, 0x00, 0x04, 0x01, 0xbc, 0x7b, 0x80, 0xc1, 0x00, 0x80, 0x02, 0xc0, 0xf7, 0x7f, 0x03, 0x00
};
// 32x32
static const unsigned char icon_routing_32[] PROGMEM = {
  0x00, 0x00, 0x00, 0x03, 0x00, 0x00, 0x00, 0x0f, 0x00, 0x00, 0x00, 0x39, 0x00, 0x00, 0x00, 0x61, 
  0x00, 0x00, 0x00, 0x61, 0x00, 0x00, 0x00, 0x39, 0x00, 0x00, 0x00, 0x0f, 0x00, 0x00, 0x00, 0x03, 
  0x00, 0x00, 0x00, 0x01, 0x00, 0x00, 0x00, 0x01, 0x00, 0x00, 0x00, 0x01, 0x00, 0x00, 0x00, 0x01, 
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  0x13, 0x00, 0x00, 0x60, 0x11, 0xff, 0xff, 0x3f, 0x1b, 0xff, 0xff, 0x0f, 0x0e, 0x00, 0x00, 0x00
};


// --- SYNC icon (clock icon) ---
// 16x16
static const unsigned char icon_sync_16[] PROGMEM = {
	0xe0, 0x07, 0xf8, 0x1f, 0x3c, 0x3c, 0x8e, 0x70, 0x86, 0x61, 0x87, 0xe1, 0x83, 0xc1, 0x83, 0xc7, 
	0x83, 0xc7, 0x03, 0xc0, 0x07, 0xe0, 0x06, 0x60, 0x0e, 0x70, 0x3c, 0x3c, 0xf8, 0x1f, 0xe0, 0x07
};
// 32x32
static const unsigned char icon_sync_32[] PROGMEM = {
	0x00, 0xf0, 0x0f, 0x00, 0x00, 0xfe, 0x7f, 0x00, 0x80, 0xff, 0xff, 0x01, 0xc0, 0xff, 0xff, 0x03, 
	0xe0, 0x1f, 0xf8, 0x07, 0xf0, 0x03, 0xc0, 0x0f, 0xf8, 0x01, 0x80, 0x1f, 0xfc, 0xc0, 0x01, 0x3f, 
	0x7c, 0xe0, 0x01, 0x3e, 0x3e, 0xe0, 0x01, 0x7c, 0x1e, 0xe0, 0x01, 0x78, 0x1e, 0xe0, 0x01, 0x78, 
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	0xc0, 0xff, 0xff, 0x03, 0x80, 0xff, 0xff, 0x01, 0x00, 0xfe, 0x7f, 0x00, 0x00, 0xf0, 0x0f, 0x00
};

// --- PRESET icon (floppy/save disk) ---
// 16x16
static const unsigned char icon_preset_16[] PROGMEM = {
	0xfe, 0x1f, 0x1b, 0x38, 0x19, 0x78, 0x19, 0xd8, 0xf9, 0x9f, 0x01, 0x80, 0x01, 0x80, 0xc1, 0x83, 
	0x61, 0x82, 0x61, 0x86, 0xc1, 0x82, 0x81, 0x81, 0x01, 0x80, 0x01, 0x80, 0x03, 0xc0, 0xff, 0xff
};
// 32x32
static const unsigned char icon_preset_32[] PROGMEM = {
	0xfc, 0xff, 0xff, 0x03, 0xfe, 0xff, 0xff, 0x07, 0xff, 0xff, 0xff, 0x0f, 0x87, 0x01, 0x80, 0x1f, 
	0x87, 0x01, 0x80, 0x3d, 0x87, 0x01, 0x80, 0x79, 0x87, 0x01, 0x80, 0xf1, 0x87, 0x01, 0x80, 0xe1, 
	0x87, 0xff, 0xff, 0xe1, 0x87, 0xff, 0xff, 0xe1, 0x87, 0xff, 0xff, 0xe1, 0x07, 0x00, 0x00, 0xe0, 
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	0x07, 0x00, 0x00, 0xe0, 0xff, 0xff, 0xff, 0xff, 0xff, 0xff, 0xff, 0xff, 0xff, 0xff, 0xff, 0xff
};

// --- INFO icon (letter "i" in a circle) ---
// 16x16
static const unsigned char icon_info_16[] PROGMEM = {
	0xe0, 0x07, 0x78, 0x1e, 0x0c, 0x30, 0x06, 0x60, 0x82, 0x41, 0x03, 0xc0, 0x03, 0xc0, 0x81, 0x81, 
	0x01, 0x81, 0x03, 0xc1, 0x03, 0xc1, 0x02, 0x41, 0x06, 0x61, 0x0c, 0x30, 0x78, 0x1e, 0xe0, 0x07
};
// 32x32
static const unsigned char icon_info_32[] PROGMEM = {
	0x00, 0xf0, 0x0f, 0x00, 0x00, 0xfe, 0x7f, 0x00, 0x80, 0xff, 0xff, 0x01, 0xc0, 0x07, 0xe0, 0x03, 
	0xe0, 0x01, 0x80, 0x07, 0xf0, 0x00, 0x00, 0x0f, 0x78, 0x00, 0x00, 0x1e, 0x3c, 0xc0, 0x03, 0x3c, 
	0x1c, 0xc0, 0x03, 0x38, 0x0e, 0xc0, 0x03, 0x70, 0x0e, 0x80, 0x01, 0x70, 0x06, 0x00, 0x00, 0x60, 
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	0xc0, 0x07, 0xf0, 0x03, 0x80, 0xff, 0xff, 0x01, 0x00, 0xfe, 0x7f, 0x00, 0x00, 0xf0, 0x0f, 0x00
};

// --- MONITOR icon (4 VU-meter bars inside a frame) ---
// 16x16
static const unsigned char icon_monitor_16[] PROGMEM = {
    0xFF, 0xFF,  // row  0 : top border
    0x01, 0x80,  // row  1 : left/right border
    0x05, 0x80,  // row  2 : + bar col2 (tall)
    0x05, 0x80,  // row  3
    0x05, 0x80,  // row  4
    0x25, 0x80,  // row  5 : + bar col5 (medium-tall)
    0x25, 0x80,  // row  6
    0x25, 0x80,  // row  7
    0x25, 0x81,  // row  8 : + bar col8 (medium)
    0x25, 0x81,  // row  9
    0x25, 0x89,  // row 10 : + bar col11 (short)
    0x25, 0x89,  // row 11
    0x25, 0x89,  // row 12
    0x25, 0x89,  // row 13
    0x01, 0x80,  // row 14 : left/right border
    0xFF, 0xFF   // row 15 : bottom border
};
// 32x32
static const unsigned char icon_monitor_32[] PROGMEM = {
    0xFF,0xFF,0xFF,0xFF,  // row  0 : top border
    0x01,0x00,0x00,0x80,  // row  1
    0x31,0x00,0x00,0x80,  // row  2 : bar1 (cols 4-5)
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    0xFF,0xFF,0xFF,0xFF   // row 31 : bottom border
};

// -----------------------------------------------------------------
// ICON DESCRIPTOR — add new icons here, bitmaps above
// -----------------------------------------------------------------

struct CarouselIcon {
  const char*          label;
  const unsigned char* bmp16;   // 16x16 bitmap (PROGMEM)
  const unsigned char* bmp32;   // 32x32 bitmap (PROGMEM)
};

// Generic draw helper — call this to render any icon at any size/position.
// size must be 16 or 32. Uses U8g2 drawXBMP (LSB-first, PROGMEM-safe).
void drawIcon(int x, int y, int size, const unsigned char* bmp) {
  u8g2.drawXBMP(x, y, size, size, bmp);
}

// -----------------------------------------------------------------
// CAROUSEL STATE
// -----------------------------------------------------------------

#define CAROUSEL_ITEMS_MAX 8

struct CarouselItem {
  const char*          label;
  const unsigned char* bmp16;
  const unsigned char* bmp32;
  void (*onSelect)();   // called when user validates this item
};

static CarouselItem  carousel_items[CAROUSEL_ITEMS_MAX];
static uint8_t       carousel_count     = 0;
static int           carousel_selected  = 0;

// Fractional pixel offset for smooth scroll animation (fixed-point, 256 = 1 slot)
static int16_t       carousel_anim_offset = 0;  // 0 = settled
static const int8_t  ANIM_STEP = 16; // pixels per frame to slide

// -----------------------------------------------------------------
// CAROUSEL SETUP — call once during setup() after menu init
// -----------------------------------------------------------------

void carousel_register(const char* label,
                       const unsigned char* bmp16,
                       const unsigned char* bmp32,
                       void (*onSelect)()) {
  if (carousel_count >= CAROUSEL_ITEMS_MAX) return;
  carousel_items[carousel_count++] = {label, bmp16, bmp32, onSelect};
}

// -----------------------------------------------------------------
// DRAW HELPERS
// -----------------------------------------------------------------

// Screen constants (SSD1306 128x64)
#define SCREEN_W  128
#define SCREEN_H  64
#define ICON_BIG   32
#define ICON_SMALL 16
#define LABEL_Y    58   // baseline for bottom label text

// -----------------------------------------------------------------
// GLOBAL FONT SCALE — change these three lines to resize all sub-menu text
#define UI_FONT_TITLE  u8g2_font_7x13_tf   // section headers  (7×13 px)
#define UI_FONT_BODY   u8g2_font_6x10_tf   // list items / body text (6×10 px)
#define UI_FONT_SMALL  u8g2_font_5x7_tf    // tight areas: grids, slot labels, badges (5×7 px)
// -----------------------------------------------------------------

// 5-icon layout — total: 16+4+16+4+32+4+16+4+16 = 112px → 8px margin each side
#define ICON_FAR_LEFT_X    8
#define ICON_NEAR_LEFT_X  28
#define CENTER_X          48
#define ICON_NEAR_RIGHT_X 84
#define ICON_FAR_RIGHT_X 104

// Y positions
#define BIG_ICON_Y   ((48 - ICON_BIG)   / 2)   // = 8
#define SMALL_ICON_Y ((48 - ICON_SMALL) / 2)   // = 16

// Animation: pixel distance from center slot to adjacent near slot
#define CAROUSEL_SLOT_OFFSET  36

// -----------------------------------------------------------------
// CAROUSEL DRAW — renders one complete frame into U8g2 buffer
// offset_px: pixel offset of the center slot (-ve = sliding left,
//            +ve = sliding right). 0 = fully settled.
// -----------------------------------------------------------------

void carousel_draw_frame(int offset_px) {
  u8g2.clearBuffer();

  int n = carousel_count;
  if (n == 0) { u8g2.sendBuffer(); return; }

  // 5 visible slots — circular indices
  int sel   = carousel_selected;
  int prev1 = (sel + n - 1) % n;
  int prev2 = (sel + n - 2) % n;
  int next1 = (sel + 1) % n;
  int next2 = (sel + 2) % n;

  //drawIcon(ICON_FAR_LEFT_X   + offset_px, SMALL_ICON_Y, ICON_SMALL, carousel_items[prev2].bmp16);
  //drawIcon(ICON_NEAR_LEFT_X  + offset_px, SMALL_ICON_Y, ICON_SMALL, carousel_items[prev1].bmp16);
  drawIcon(CENTER_X          + offset_px, BIG_ICON_Y,   ICON_BIG,   carousel_items[sel].bmp32);
  //drawIcon(ICON_NEAR_RIGHT_X + offset_px, SMALL_ICON_Y, ICON_SMALL, carousel_items[next1].bmp16);
  //drawIcon(ICON_FAR_RIGHT_X  + offset_px, SMALL_ICON_Y, ICON_SMALL, carousel_items[next2].bmp16);

  // Label centered, larger font
  u8g2.setFont(u8g2_font_8x13_tf);
  const char* lbl = carousel_items[sel].label;
  int lbl_w = u8g2.getStrWidth(lbl);
  u8g2.drawStr((SCREEN_W - lbl_w) / 2, LABEL_Y, lbl);

  u8g2.sendBuffer();
}

// -----------------------------------------------------------------
// CAROUSEL UPDATE — call every ~50 ms from the interactive loop
// Handles encoder input and animation ticking.
// Returns true if user just validated a selection.
// -----------------------------------------------------------------

bool carousel_update(bool enc_up, bool enc_down, bool btn_valid) {

  // Animate towards zero offset
  if (carousel_anim_offset != 0) {
    if (carousel_anim_offset > 0) {
      carousel_anim_offset -= ANIM_STEP;
      if (carousel_anim_offset < 0) carousel_anim_offset = 0;
    } else {
      carousel_anim_offset += ANIM_STEP;
      if (carousel_anim_offset > 0) carousel_anim_offset = 0;
    }
    carousel_draw_frame(carousel_anim_offset);
    return false;
  }

  // Only accept new input when fully settled
  int n = carousel_count;
  if (n == 0) return false;

  if (enc_down) {
    carousel_selected = (carousel_selected + 1) % n;
    carousel_anim_offset = +CAROUSEL_SLOT_OFFSET;  // slide right→left
  } else if (enc_up) {
    carousel_selected = (carousel_selected + n - 1) % n;
    carousel_anim_offset = -CAROUSEL_SLOT_OFFSET;  // slide left→right
  }

  if (btn_valid) {
    if (carousel_items[carousel_selected].onSelect != NULL) {
      carousel_items[carousel_selected].onSelect();
    }
    return true;
  }

  carousel_draw_frame(carousel_anim_offset);
  return false;
}

// -----------------------------------------------------------------
// SOURCE-PORT REMINDER — draws a small "Port X" badge at the top-
// left of the screen. Call this inside sub-menu draw functions when
// you want to keep the context visible.
// -----------------------------------------------------------------

void carousel_draw_port_badge(int port_index) {
  static const char* PORT_LABELS[] = { "IN:A", "IN:B", "IN:C", "IN:D", "IN:E" };
  u8g2.setFont(UI_FONT_SMALL);
  u8g2.drawRFrame(0, 0, 24, 10, 2);
  u8g2.drawStr(3, 8, PORT_LABELS[port_index < 5 ? port_index : 0]);
}

// -----------------------------------------------------------------
// OUTPUT LABEL HELPERS
// Short codes: Sorties 1-9 → "1".."9"
// Used in sub-menu rows.
// -----------------------------------------------------------------

const char* carousel_output_label(uint8_t output_idx) {
  static char buf[4];
  snprintf(buf, sizeof(buf), "%u", output_idx + 1);
  return buf;
}

const char* carousel_channel_label(uint8_t ch) {
  // ch: 1-16
  static char buf[4];
  if (ch == 0) {
    return "OFF";
  }
  snprintf(buf, sizeof(buf), "%u", ch);
  return buf;
}
